#include <Wire.h>
#include <Adafruit_GFX.h>
#include <Adafruit_SSD1306.h>
#include <Fonts/Picopixel.h>

#define SCREEN_ADDRESS 0x3C
Adafruit_SSD1306 display(128, 64, &Wire, -1);


// 'makey_symbol', 40x40px
const unsigned char makey_symbol [] PROGMEM = {
	0x00, 0x00, 0x00, 0x00, 0x00, 0x00, 0x00, 0x00, 0x00, 0x00, 0x0f, 0xff, 0xff, 0xff, 0xf0, 0x1f, 
	0xff, 0xff, 0xff, 0xf8, 0x3f, 0xff, 0xc3, 0xff, 0xfc, 0x3f, 0xff, 0x00, 0xff, 0xfc, 0x3f, 0xfe, 
	0x00, 0x7f, 0xfc, 0x3f, 0xfc, 0x00, 0x3f, 0xfc, 0x3f, 0xf9, 0x81, 0x9f, 0xfc, 0x3f, 0xf9, 0x81, 
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	0x00, 0x00, 0x00, 0x00, 0x00, 0x00, 0x00, 0x00
};

// 'arrow_right', 8x15px
const unsigned char arrow_right [] PROGMEM = {
	0x80, 0xc0, 0xe0, 0xf0, 0xf8, 0xfc, 0xfe, 0xff, 0xfe, 0xfc, 0xf8, 0xf0, 0xe0, 0xc0, 0x80
};

// 'arrow_left', 8x15px
const unsigned char arrow_left [] PROGMEM = {
	0x01, 0x03, 0x07, 0x0f, 0x1f, 0x3f, 0x7f, 0xff, 0x7f, 0x3f, 0x1f, 0x0f, 0x07, 0x03, 0x01
};

// 'pattern', 8x4px
const unsigned char pattern [] PROGMEM = {
	0xaa, 0x55, 0xaa, 0x55
};

// 'battery_dummy', 16x7px
const unsigned char battery_dummy [] PROGMEM = {
	0xff, 0xfc, 0x80, 0x04, 0xbf, 0xc7, 0xbf, 0xc5, 0xbf, 0xc7, 0x80, 0x04, 0xff, 0xfc
};


/******************************************************/
/* Funktion zum Ausrichten SELBST GEWÄHLTER Schriften */
/******************************************************/
void customFontAlign(const String &lorem, int option, int x, int y, int fontScale, int fontColor){

  int16_t x1, y1;
  uint16_t w, h;

  display.setTextSize(fontScale);
  display.setTextColor(fontColor);
  display.getTextBounds(lorem, x, y, &x1, &y1, &w, &h);         //Größe des Textes berechnen

  if(option == 0){
    display.setCursor(x-w/2, y+h-fontScale);                              //MITTE OBEN
    
  } else if(option == 1){
    display.setCursor(x-w, y+h-fontScale);                                //RECHTS OBEN
  
  } else if(option == 2){
    display.setCursor(x-w, y+h/2-fontScale);                              //RECHTS MITTE
    
  } else if(option == 3){
    display.setCursor(x-w, y-fontScale);                                  //RECHTS UNTEN
    
  } else if(option == 4){
    display.setCursor(x-w/2, y-fontScale);                            	  //MITTE UNTEN
    
  } else if(option == 5){
    display.setCursor(x, y-fontScale);                                	  //LINKS UNTEN

  } else if(option == 6){
    display.setCursor(x, y+h/2-fontScale);				                        //LINKS MITTE

  } else if(option == 7){
    display.setCursor(x, y+h-fontScale);                                  //LINKS OBEN

  } else if(option == 8){
    display.setCursor(x-w/2, y+h/2-fontScale);				                    //MITTE MITTE

  }

  display.print(lorem);

}




void setup() {

  Serial.begin(9600);
  delay(250);
  display.begin(SSD1306_SWITCHCAPVCC, SCREEN_ADDRESS);

  display.clearDisplay();

  display.setTextWrap(false);
  display.setFont(&Picopixel);

  //Hintergrundmuster
	for(int x=0; x<128; x+=8){
		for(int y=0; y<44; y+=4){
			display.drawBitmap(x,y+10,pattern,8,4,1);
		}
	}

  customFontAlign("12:05",7,0,1,1,1);
  customFontAlign("192.168.0.24",5,0,63,1,1);

  display.drawFastHLine(0,8,128,1);
  display.drawFastHLine(0,55,128,1);

  display.drawBitmap(44,12,makey_symbol,40,40,1,0);

  display.drawBitmap(96,24,arrow_right,8,15,0);
  display.drawBitmap(24,24,arrow_left,8,15,0);

  display.drawBitmap(112,0,battery_dummy,16,7,1);

  display.display();

}

void loop() {
  
}
